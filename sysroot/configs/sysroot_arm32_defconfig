## sysroot/configs/sysroot_arm32_defconfig
```kconfig
BR2_arm=y
BR2_ARM_ENABLE_VFP=y
BR2_INIT_NONE=y
BR2_ROOTFS_MERGED_USR=y
BR2_SYSTEM_BIN_SH_NONE=y
# BR2_PACKAGE_BUSYBOX is not set
BR2_PACKAGE_SLIRP=y
```

## sysroot/configs/sysroot_riscv32_defconfig
```kconfig
BR2_riscv=y
BR2_RISCV_32=y
BR2_INIT_NONE=y
BR2_SYSTEM_BIN_SH_NONE=y
# BR2_PACKAGE_BUSYBOX is not set
BR2_PACKAGE_SLIRP=y
```

## sysroot/configs/sysroot_riscv64_defconfig
```kconfig
BR2_riscv=y
BR2_INIT_NONE=y
BR2_ROOTFS_MERGED_USR=y
BR2_SYSTEM_BIN_SH_NONE=y
# BR2_PACKAGE_BUSYBOX is not set
BR2_PACKAGE_SLIRP=y
```
